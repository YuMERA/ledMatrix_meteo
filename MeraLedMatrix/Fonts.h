#pragma once
// Fontovi su zapisani po kolonama: bit 0 je gornji red, visina 7 redova.
// Oba fonta su iste visine, pa se cifre 4x7 i slova 5x7 mesaju u istom redu.

#include <Arduino.h>

// Interni znak za stepen; UTF-8 "°" se pri prevodu teksta pretvara u njega.
#define CH_DEGREE '\x7F'
// Prazna kolona sirine 1 - koristi se da dvotacka sata trepce bez pomeranja cifara.
#define CH_BLANK1 '\x01'

// Klasicni 5x7 ASCII font, 0x20..0x7E, plus stepen na 0x7F.
static const uint8_t FONT5X7[96][5] = {
  {0x00,0x00,0x00,0x00,0x00}, // ' '
  {0x00,0x00,0x5F,0x00,0x00}, // !
  {0x00,0x07,0x00,0x07,0x00}, // "
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  {0x00,0x06,0x09,0x09,0x06}, // stepen (0x7F)
};

// Uze cifre 4x7 - da "-12.3°C" i "1013 hPa" stanu u 32 kolone.
static const uint8_t DIGITS4X7[10][4] = {
  {0x3E,0x41,0x41,0x3E}, // 0
  {0x00,0x42,0x7F,0x40}, // 1
  {0x62,0x51,0x49,0x46}, // 2
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  {0x26,0x49,0x49,0x3E}, // 9
};

static const uint8_t SYM_MINUS[]  = {0x08,0x08,0x08};
static const uint8_t SYM_DOT[]    = {0x40};
static const uint8_t SYM_COLON[]  = {0x14};
static const uint8_t SYM_DEGREE[] = {0x07,0x05,0x07};
static const uint8_t SYM_SPACE[]  = {0x00,0x00};
static const uint8_t SYM_BLANK1[] = {0x00};


// Mala slova srpske latinice sa kvacicom, interni kodovi 0x80..0x84.
// Mala slova 5x7 pocinju u trecem redu, pa kvacica staje iznad njih.
// Velika slova nemaju mesta i ostaju bez kvacice (C, S, Z, Dj).
#define CH_SR_C_CARON '\x80'  // č
#define CH_SR_C_ACUTE '\x81'  // ć
#define CH_SR_S_CARON '\x82'  // š
#define CH_SR_Z_CARON '\x83'  // ž
#define CH_SR_D_BAR   '\x84'  // đ

static const uint8_t FONT5X7_SR[5][5] = {
  {0x38,0x45,0x46,0x45,0x20}, // č
  {0x38,0x44,0x46,0x45,0x20}, // ć
  {0x48,0x55,0x56,0x55,0x20}, // š
  {0x44,0x65,0x56,0x4D,0x44}, // ž
  {0x38,0x44,0x44,0x4A,0x7F}, // đ
};

// Mali 3x5 font za jedinice (hPa, m/s, mm...), 5 redova. Mala slova se
// crtaju kao velika - na 5 redova razlike ionako nema.
static const uint8_t FONT3X5_AZ[26][3] = {
  {0x1E,0x05,0x1E}, // A
  {0x1F,0x15,0x0A}, // B
  {0x0E,0x11,0x11}, // C
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  {0x19,0x15,0x13}, // Z
};

static const uint8_t FONT3X5_DIGITS[10][3] = {
  {0x1F,0x11,0x1F}, {0x12,0x1F,0x10}, {0x1D,0x15,0x17}, {0x15,0x15,0x1F},
  {0x07,0x04,0x1F}, {0x17,0x15,0x1D}, {0x1F,0x15,0x1D}, {0x01,0x01,0x1F},
  {0x1F,0x15,0x1F}, {0x17,0x15,0x1F},
};

static const uint8_t SMALL_SLASH[]   = {0x18,0x04,0x03};
static const uint8_t SMALL_PERCENT[] = {0x19,0x04,0x13};
static const uint8_t SMALL_MINUS[]   = {0x04,0x04,0x04};
static const uint8_t SMALL_DOT[]     = {0x10};
static const uint8_t SMALL_DEGREE[]  = {0x03,0x03};

struct Glyph {
  const uint8_t* cols;
  uint8_t w;
};

// Znak koga mali font nema dobija sirinu 0 i jednostavno se preskace.
static Glyph smallGlyphFor(char c) {
  if (c >= 'a' && c <= 'z') c -= 'a' - 'A';
  if (c >= 'A' && c <= 'Z') return {FONT3X5_AZ[c - 'A'], 3};
  if (c >= '0' && c <= '9') return {FONT3X5_DIGITS[c - '0'], 3};
  switch (c) {
    case '/':       return {SMALL_SLASH, 3};
    case '%':       return {SMALL_PERCENT, 3};
    case '-':       return {SMALL_MINUS, 3};
    case '.':       return {SMALL_DOT, 1};
    case CH_DEGREE: return {SMALL_DEGREE, 2};
  }
  return {nullptr, 0};
}

static Glyph glyphFor(char c) {
  uint8_t u = (uint8_t)c;
  if (u >= 0x80 && u <= 0x84) return {FONT5X7_SR[u - 0x80], 5};
  if (c >= '0' && c <= '9') return {DIGITS4X7[c - '0'], 4};
  switch (c) {
    case '-':       return {SYM_MINUS, 3};
    case '.':       return {SYM_DOT, 1};
    case ':':       return {SYM_COLON, 1};
    case ' ':       return {SYM_SPACE, 2};
    case CH_DEGREE: return {SYM_DEGREE, 3};
    case CH_BLANK1: return {SYM_BLANK1, 1};
  }
  if (u >= 0x20 && u <= 0x7F) return {FONT5X7[u - 0x20], 5};
  return {FONT5X7['?' - 0x20], 5};
}
